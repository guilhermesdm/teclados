## oldkeebs/boards/shields/oldkeebs/Kconfig.defconfig
```kconfig
if SHIELD_OLDKEEBS_LEFT

config ZMK_KEYBOARD_NAME
    default "Oldkeebs"

config ZMK_SPLIT_ROLE_CENTRAL
    default y

endif

if SHIELD_OLDKEEBS_RIGHT

config ZMK_KEYBOARD_NAME
    default "Oldkeebs Right"

endif

if SHIELD_OLDKEEBS_DONGLE

config ZMK_KEYBOARD_NAME
    default "Oldkeebs Dongle"

config ZMK_SPLIT_ROLE_CENTRAL
    default y

config ZMK_USB
    default y

endif

if SHIELD_OLDKEEBS_LEFT || SHIELD_OLDKEEBS_RIGHT || SHIELD_OLDKEEBS_DONGLE

config ZMK_SPLIT
    default y

endif
```

## oldkeebs/boards/shields/oldkeebs/Kconfig.shield
```kconfig
config SHIELD_OLDKEEBS_LEFT
    def_bool $(shields_list_contains,oldkeebs_left)

config SHIELD_OLDKEEBS_RIGHT
    def_bool $(shields_list_contains,oldkeebs_right)

config SHIELD_OLDKEEBS_DONGLE
    def_bool $(shields_list_contains,oldkeebs_dongle)
```
